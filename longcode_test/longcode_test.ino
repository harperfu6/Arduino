byte val;
bool isOn = true;

int ir_out = 2;
int led = 9;

int last = 0;
unsigned long us = micros();

enum Button{
AIRCON_ON,
AIRCON_OFF,
DRIVE_AUTO,
DRIVE_COOL,
DRIVE_DRY,
DRIVE_WARM,
WIND_AUTO,
WIND_LIGHT,
WIND_STRONG,
WIND_HARD,
TEMP_16,
TEMP_17,
TEMP_18,
TEMP_19,
TEMP_20,
TEMP_21,
TEMP_22,
TEMP_23,
TEMP_24,
TEMP_25,
TEMP_26,
TEMP_27,
TEMP_28,
TEMP_29,
TEMP_30,
TEMP_31,
AUTO_FLAP
};


// エアコンオフ
unsigned int aircon_off[] = {614,184,66,58,65,57,66,58,65,58,65,182,66,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58,65};
//エアコンオン
unsigned int aircon_on[] = {614,184,66,182,66,182,65,58,65,57,66,182,66,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58,65};

//運転切換
//自動
unsigned int drive_auto[] = {616,182,68,182,65,182,65,58,65,58,66,182,66,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58,65};
//冷房
unsigned int drive_cool[] = {616,185,65,182,66,182,65,58,65,57,66,182,66,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58,65};
//ドライ
unsigned int drive_dry[] = {614,184,66,182,65,182,65,58,65,57,66,182,66,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58,65};
//暖房
unsigned int drive_warm[] = {619,185,65,182,65,182,66,58,65,58,65,182,66,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57,66};

//風速
//自動
unsigned int wind_auto[] = {619,184,66,182,66,182,65,58,65,58,65,182,66,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58,65};
//弱
unsigned int wind_light[] = {617,184,66,182,65,182,66,58,65,58,65,182,66,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58,65};
//強
unsigned int wind_strong[] = {616,184,66,182,65,182,65,58,66,58,65,182,65,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58,65};
//急
unsigned int wind_hard[] = {617,184,65,182,65,182,66,57,66,58,66,181,66,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58,65};

//温度
//16
unsigned int temp_16[] = {614,184,66,182,65,182,65,58,65,58,65,182,65,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58,65};
//17
unsigned int temp_17[] = {614,184,66,182,65,182,65,58,65,58,65,182,65,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58,65};
//18
unsigned int temp_18[] = {619,184,66,182,66,182,66,58,65,57,66,182,66,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58,65};
//19
unsigned int temp_19[] = {616,185,65,182,65,182,66,58,65,58,65,181,66,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58,65};
//20
unsigned int temp_20[] = {616,185,65,182,66,182,66,58,65,58,66,182,65,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58,65};
//21
unsigned int temp_21[] = {616,184,66,182,66,182,66,57,66,58,65,182,66,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58,65};
//22
unsigned int temp_22[] = {614,184,66,182,65,182,66,58,65,58,66,182,65,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58,65};
//23
unsigned int temp_23[] = {614,184,66,182,65,182,65,58,65,58,66,182,66,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58,65};
//24
unsigned int temp_24[] = {616,185,65,182,66,182,65,57,66,58,65,182,65,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58,66};
//25
unsigned int temp_25[] = {616,184,66,182,65,182,65,58,65,58,66,182,65,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58,65};
//26
unsigned int temp_26[] = {614,184,65,182,66,182,66,58,65,58,65,182,66,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58,65};
//27
unsigned int temp_27[] = {616,184,66,182,65,182,66,57,66,58,65,182,64,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58,65};
//28
unsigned int temp_28[] = {619,184,66,182,65,182,66,58,65,58,65,182,65,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58,65};
//29
unsigned int temp_29[] = {614,184,66,182,65,182,66,58,65,58,65,182,65,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58,65};
//30
unsigned int temp_30[] = {616,184,65,182,65,182,66,58,65,58,66,182,66,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58,65};
//31
unsigned int temp_31[] = {616,184,66,182,65,182,65,58,65,58,65,182,65,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58,66};


//タイマー切換
//連続
unsigned int timer_continue[] = {616,184,66,182,66,182,65,58,65,58,66,182,65,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182,66};
//切
unsigned int timer_off[] = {616,185,65,182,65,182,66,58,65,58,65,182,66,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182,65};
//入
unsigned int timer_on[] = {616,184,66,182,65,182,66,57,66,58,65,182,66,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182,65};

//タイマー時間
//1
unsigned int timer_1[] = {616,185,65,182,65,182,65,58,66,58,65,182,65,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182,66};
//2
unsigned int timer_2[] = {619,185,65,182,66,182,66,58,65,58,66,182,65,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182,65};
//3
unsigned int timer_3[] = {614,185,65,182,66,182,65,57,66,58,65,182,66,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182,65};
//4
unsigned int timer_4[] = {613,185,65,182,65,182,65,57,66,58,65,182,65,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182,65};
//5
unsigned int timer_5[] = {614,184,66,182,65,182,66,58,66,58,65,182,66,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182,65};
//6
unsigned int timer_6[] = {619,184,66,182,65,182,65,58,65,58,65,182,66,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182,66};
//7
unsigned int timer_7[] = {614,184,66,182,65,182,66,57,65,58,66,182,65,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181,66};
//8
unsigned int timer_8[] = {616,185,65,182,66,182,66,57,66,58,65,182,66,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182,66};
//9
unsigned int timer_9[] = {614,184,66,182,65,182,65,58,65,58,65,182,65,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182,66};
//10
unsigned int timer_10[] = {614,184,66,182,65,182,66,55,68,58,66,182,66,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182,65};
//11
unsigned int timer_11[] = {619,184,66,182,66,182,66,57,66,58,65,182,66,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179,68};
//12
unsigned int timer_12[] = {614,184,66,182,66,182,65,57,66,58,65,182,66,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182,66};

//オートフラップ
unsigned int auto_flap[] = {614,184,66,182,65,182,66,58,66,58,66,182,66,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58,65};

 
// セットアップ
void setup() {
  // Serial Setting
  Serial.begin(9600);
  
  pinMode(ir_out, OUTPUT);
  pinMode(led, OUTPUT);
}

//実際にデータを送る処理
void sendData(unsigned int data[], int dataSize){
  
  for (int cnt = 0; cnt < dataSize; cnt++) {
    unsigned long len = data[cnt]*10;  // dataは10us単位でON/OFF時間を記録している
    unsigned long us = micros();
    do {
      digitalWrite(ir_out, 1 - (cnt&1)); // cntが偶数なら赤外線ON、奇数ならOFFのまま
      delayMicroseconds(8);  // キャリア周波数38kHzでON/OFFするよう時間調整
      digitalWrite(ir_out, 0);
      delayMicroseconds(7);
    } while (long(us + len - micros()) > 0); // 送信時間に達するまでループ
  }
}

// 送る信号を決定
void sendSignal(int button) {

  int dataSize;

  switch (button){
    case AIRCON_OFF:{
      dataSize = sizeof(aircon_off) / sizeof(aircon_off[0]);
      sendData(aircon_off, dataSize);
    }
      break;
    case AIRCON_ON:{
      dataSize = sizeof(aircon_on) / sizeof(aircon_on[0]);
      sendData(aircon_on, dataSize);
    }
      break;
    case DRIVE_AUTO:{
      dataSize = sizeof(drive_auto) / sizeof(drive_auto[0]);
      sendData(drive_auto, dataSize);
    }
    case DRIVE_COOL:{
      dataSize = sizeof(drive_cool) / sizeof(drive_cool[0]);
      sendData(drive_cool, dataSize);
    }
    case DRIVE_DRY:{
      dataSize = sizeof(drive_dry) / sizeof(drive_dry[0]);
      sendData(drive_dry, dataSize);
    }
    case DRIVE_WARM:{
      dataSize = sizeof(drive_warm) / sizeof(drive_warm[0]);
      sendData(drive_warm, dataSize);
    }
    case WIND_AUTO:{
      dataSize = sizeof(wind_auto) / sizeof(wind_auto[0]);
      sendData(wind_auto, dataSize);
    }
    case WIND_LIGHT:{
      dataSize = sizeof(wind_light) / sizeof(wind_light[0]);
      sendData(wind_light, dataSize);
    }
    case WIND_STRONG:{
      dataSize = sizeof(wind_strong) / sizeof(wind_strong[0]);
      sendData(wind_strong, dataSize);
    }
    case WIND_HARD:{
      dataSize = sizeof(wind_hard) / sizeof(wind_hard[0]);
      sendData(wind_hard, dataSize);
    }
    case TEMP_16:{
      dataSize = sizeof(temp_16) / sizeof(temp_16[0]);
      sendData(temp_16, dataSize);
    }
    case TEMP_17:{
      dataSize = sizeof(temp_17) / sizeof(temp_17[0]);
      sendData(temp_17, dataSize);
    }
    case TEMP_18:{
      dataSize = sizeof(temp_18) / sizeof(temp_18[0]);
      sendData(temp_18, dataSize);
    }
    case TEMP_19:{
      dataSize = sizeof(temp_19) / sizeof(temp_19[0]);
      sendData(temp_19, dataSize);
    }
    case TEMP_20:{
      dataSize = sizeof(temp_20) / sizeof(temp_20[0]);
      sendData(temp_20, dataSize);
    }
    case TEMP_21:{
      dataSize = sizeof(temp_21) / sizeof(temp_21[0]);
      sendData(temp_21, dataSize);
    }
    case TEMP_22:{
      dataSize = sizeof(temp_22) / sizeof(temp_22[0]);
      sendData(temp_22, dataSize);
    }
    case TEMP_23:{
      dataSize = sizeof(temp_23) / sizeof(temp_23[0]);
      sendData(temp_23, dataSize);
    }
    case TEMP_24:{
      dataSize = sizeof(temp_24) / sizeof(temp_24[0]);
      sendData(temp_24, dataSize);
    }
    case TEMP_25:{
      dataSize = sizeof(temp_25) / sizeof(temp_25[0]);
      sendData(temp_25, dataSize);
    }
    case TEMP_26:{
      dataSize = sizeof(temp_26) / sizeof(temp_26[0]);
      sendData(temp_26, dataSize);
    }
    case TEMP_27:{
      dataSize = sizeof(temp_27) / sizeof(temp_27[0]);
      sendData(temp_27, dataSize);
    }
    case TEMP_28:{
      dataSize = sizeof(temp_28) / sizeof(temp_28[0]);
      sendData(temp_28, dataSize);
    }
    case TEMP_29:{
      dataSize = sizeof(temp_29) / sizeof(temp_29[0]);
      sendData(temp_29, dataSize);
    }
    case TEMP_30:{
      dataSize = sizeof(temp_30) / sizeof(temp_30[0]);
      sendData(temp_30, dataSize);
    }
    case TEMP_31:{
      dataSize = sizeof(temp_31) / sizeof(temp_31[0]);
      sendData(temp_31, dataSize);
    }
    case AUTO_FLAP:{
      dataSize = sizeof(auto_flap) / sizeof(auto_flap[0]);
      sendData(auto_flap, dataSize);
    }
      break;
    default:{}
      break;
    }
}

void loop() {

  if(Serial.available() > 0){
    
    val = Serial.read();
    Serial.write(val);
    if(val == 'a'){
      digitalWrite(led, HIGH);
      sendSignal(AIRCON_ON);
    }
    else if(val == 'b'){
      digitalWrite(led, LOW);
      sendSignal(AIRCON_OFF);
    }
    else if(val == 'c'){
      sendSignal(DRIVE_AUTO);
    }
    else if(val == 'd'){
      sendSignal(DRIVE_COOL);
    }
    else if(val == 'e'){
      sendSignal(DRIVE_DRY);
    }
    else if(val == 'f'){
      sendSignal(DRIVE_WARM);
    }
    else if(val == 'g'){
      sendSignal(WIND_AUTO);
    }
    else if(val == 'h'){
      sendSignal(WIND_LIGHT);
    }
    else if(val == 'i'){
      sendSignal(WIND_STRONG);
    }
    else if(val == 'j'){
      sendSignal(WIND_HARD);
    }
    else if(val == 'k'){
      sendSignal(TEMP_16);
    }
    else if(val == 'l'){
      sendSignal(TEMP_17);
    }
    else if(val == 'm'){
      sendSignal(TEMP_18);
    }
    else if(val == 'n'){
      sendSignal(TEMP_19);
    }
    else if(val == 'o'){
      sendSignal(TEMP_20);
    }
    else if(val == 'p'){
      sendSignal(TEMP_21);
    }
    else if(val == 'q'){
      sendSignal(TEMP_22);
    }
    else if(val == 'r'){
      sendSignal(TEMP_23);
    }
    else if(val == 's'){
      sendSignal(TEMP_24);
    }
    else if(val == 't'){
      sendSignal(TEMP_25);
    }
    else if(val == 'u'){
      sendSignal(TEMP_26);
    }
    else if(val == 'v'){
      sendSignal(TEMP_27);
    }
    else if(val == 'w'){
      sendSignal(TEMP_28);
    }
    else if(val == 'x'){
      sendSignal(TEMP_29);
    }
    else if(val == 'y'){
      sendSignal(TEMP_30);
    }
    else if(val == 'z'){
      sendSignal(TEMP_31);
    }
    else if(val == 'A'){
      sendSignal(AUTO_FLAP);
    }    
  }

  
//  if(isOn){
//    sendSignal(AIRCON_OFF);
//    isOn = false;
//  }
//  else{
//    sendSignal(AIRCON_ON);
//    isOn = true;
//  }
//  delay(3000);
}


