int ir_out = 13;
int led = 9;
 
// エアコンオン（冷房、26度 微）
//unsigned int data[] = {342,163,47,120,50,33,48,40,44,40,36,48,36,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129,41};
 
// エアコンオフ
//unsigned int data[] = {347,158,53,114,53,28,55,28,56,28,56,26,57,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115,52};
 
//TV制御ボタン
//unsigned int dataOn[] = {356,166,48,39,48,125,51,36,51,35,49,38,48,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122,51};
unsigned int data4[] = {353,166,51,36,50,122,49,38,51,36,51,36,50,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122,51};
unsigned int data6[] = {353,169,51,36,47,125,51,36,50,35,48,38,48,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126,51};

int last = 0;
unsigned long us = micros();
 
// セットアップ
void setup() {
  pinMode(ir_out, OUTPUT);
  pinMode(led, OUTPUT);
}
 
// dataからリモコン信号を送信
void sendSignal(int channel) {
  int dataSize = sizeof(data4) / sizeof(data4[0]);
  unsigned int data[dataSize];
  if(channel == 4){
    for(int i = 0; i < dataSize; i++){
      data[i] = data4[i];
    }
  }
  else{
    for(int i = 0; i < dataSize; i++){
      data[i] = data6[i];
    }
  }
  //int dataSize = sizeof(data) / sizeof(data[0]);
  for (int cnt = 0; cnt < dataSize; cnt++) {
    unsigned long len = data[cnt]*10;  // dataは10us単位でON/OFF時間を記録している
    unsigned long us = micros();
    do {
      digitalWrite(ir_out, 1 - (cnt&1)); // cntが偶数なら赤外線ON、奇数ならOFFのまま
      delayMicroseconds(8);  // キャリア周波数38kHzでON/OFFするよう時間調整
      digitalWrite(ir_out, 0);
      delayMicroseconds(7);
    } while (long(us + len - micros()) > 0); // 送信時間に達するまでループ
  }
}
 
void loop() {
  digitalWrite(led, HIGH);
  sendSignal(4);
  digitalWrite(led, LOW);
  delay(10000);
  digitalWrite(led, HIGH);
  sendSignal(6);
  digitalWrite(led, LOW);
  delay(10000);
}
